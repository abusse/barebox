## arch/arm/configs/gumstix_verdex_defconfig
```kconfig
CONFIG_ARCH_PXA=y
CONFIG_MACH_GUMSTIX_VERDEX=y
CONFIG_AEABI=y
CONFIG_ARM_OPTIMZED_STRING_FUNCTIONS=y
CONFIG_BOOT_ATAGS=y
CONFIG_NAME="gumstix_verdex_defconfig"
CONFIG_MMU=y
CONFIG_MALLOC_SIZE=0x1000000
CONFIG_MALLOC_TLSF=y
CONFIG_PROMPT="gumstix:"
CONFIG_HUSH_FANCY_PROMPT=y
CONFIG_CMDLINE_EDITING=y
CONFIG_AUTO_COMPLETE=y
CONFIG_BOOTM_SHOW_TYPE=y
CONFIG_BOOTM_VERBOSE=y
CONFIG_BOOTM_INITRD=y
CONFIG_BOOTM_OFTREE_UIMAGE=y
CONFIG_BOOTM_OFTREE=y
CONFIG_CONSOLE_ACTIVATE_FIRST=y
CONFIG_DEFAULT_ENVIRONMENT_GENERIC_NEW=y
CONFIG_RESET_SOURCE=y
CONFIG_LONGHELP=y
CONFIG_CMD_IOMEM=y
CONFIG_CMD_MEMINFO=y
# CONFIG_CMD_BOOTU is not set
CONFIG_CMD_BOOTZ=y
CONFIG_CMD_GO=y
CONFIG_CMD_LOADB=y
CONFIG_CMD_LOADY=y
CONFIG_CMD_RESET=y
CONFIG_CMD_UIMAGE=y
CONFIG_CMD_PARTITION=y
CONFIG_CMD_EXPORT=y
CONFIG_CMD_LOADENV=y
CONFIG_CMD_PRINTENV=y
CONFIG_CMD_MAGICVAR=y
CONFIG_CMD_SAVEENV=y
CONFIG_CMD_FILETYPE=y
CONFIG_CMD_LN=y
CONFIG_CMD_MD5SUM=y
CONFIG_CMD_UNCOMPRESS=y
CONFIG_CMD_LET=y
CONFIG_CMD_MSLEEP=y
CONFIG_CMD_READF=y
CONFIG_CMD_SLEEP=y
CONFIG_CMD_DHCP=y
CONFIG_CMD_MIITOOL=y
CONFIG_CMD_PING=y
CONFIG_CMD_TFTP=y
CONFIG_CMD_ECHO_E=y
CONFIG_CMD_EDIT=y
CONFIG_CMD_READLINE=y
CONFIG_CMD_TIMEOUT=y
CONFIG_CMD_CRC=y
CONFIG_CMD_MM=y
CONFIG_CMD_CLK=y
CONFIG_CMD_DETECT=y
CONFIG_CMD_FLASH=y
CONFIG_CMD_GPIO=y
CONFIG_CMD_WD=y
CONFIG_CMD_OFTREE=y
CONFIG_CMD_OF_NODE=y
CONFIG_CMD_OF_PROPERTY=y
CONFIG_CMD_TIME=y
CONFIG_NET=y
CONFIG_OF_BAREBOX_DRIVERS=y
CONFIG_DEBUG_LL=y
CONFIG_DEBUG_PXA_UART=y
CONFIG_DRIVER_SERIAL_PXA=y
CONFIG_DRIVER_NET_SMC91111=y
CONFIG_DRIVER_NET_SMC911X=y
CONFIG_MTD=y
CONFIG_DRIVER_CFI=y
CONFIG_CFI_BUFFER_WRITE=y
CONFIG_MCI=y
CONFIG_MCI_STARTUP=y
CONFIG_MCI_PXA=y
CONFIG_WATCHDOG=y
CONFIG_FS_TFTP=y
CONFIG_FS_NFS=y
CONFIG_FS_FAT=y
CONFIG_FS_FAT_WRITE=y
CONFIG_FS_JFFS2=y
CONFIG_FS_EXT4=y
CONFIG_GPIO_PXA=y
CONFIG_IMAGE_COMPRESSION_XZKERN=y
```

## arch/arm/mach-pxa/Kconfig
```kconfig
# SPDX-License-Identifier: GPL-2.0-only

if ARCH_PXA

# ----------------------------------------------------------

config ARCH_PXA2XX
	bool
	select CPU_XSCALE
	select HAVE_CLK
	select COMMON_CLK
	select COMMON_CLK_OF_PROVIDER

config ARCH_PXA25X
	bool
	select ARCH_PXA2XX

config ARCH_PXA27X
	bool
	select ARCH_PXA2XX

config ARCH_PXA3XX
	bool
	select CPU_XSC3
	select HAVE_CLK
	select COMMON_CLK
	select COMMON_CLK_OF_PROVIDER

config ARCH_PXA300
	bool
	select ARCH_PXA3XX

config ARCH_PXA310
	bool
	select ARCH_PXA3XX

config BAREBOX_UPDATE_PXA_NAND
	prompt "barebox update NAND handler"
	bool
	depends on ARCH_PXA3XX && BAREBOX_UPDATE && MTD
	help
	  Say Y here for an update handler that writes the image built by
	  scripts/pxa-image - the NTIM header, the OBM and barebox - to the
	  mtd partition the Boot ROM boots from.

comment "Intel/Marvell PXA boards"

config MACH_GUMSTIX_VERDEX
	bool "Gumstix verdex / verdex pro"
	select ARCH_PXA27X
	depends on !MACH_GUMSTIX_CONNEX && !ARCH_PXA3XX
	help
	  Say Y here if you are using a Gumstix verdex or verdex pro (PXA270)
	  COM. barebox can boot from NOR flash or be chain-loaded into SDRAM
	  by the Gumstix U-Boot.

config MACH_GUMSTIX_CONNEX
	bool "Gumstix basix / connex"
	select ARCH_PXA25X
	depends on !ARCH_PXA3XX
	help
	  Say Y here if you are using a Gumstix basix or connex (PXA255) COM.
	  barebox runs as second stage only, after a loader that has set up
	  the SDRAM.

config MACH_RAUMFELD_SPEAKER
	bool "Raumfeld Speaker"
	select ARCH_PXA300
	help
	  Say Y here if you are using the Raumfeld Speaker, a PXA303
	  based WLAN speaker. The Boot ROM loads barebox from NAND, so
	  it does the pinmuxing, clock and DRAM setup itself.

endif
```
